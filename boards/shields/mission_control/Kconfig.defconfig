## boards/shields/mission_control/Kconfig.defconfig
```kconfig
if SHIELD_MISSION_CONTROL_LEFT

# Name must be less than 16 characters long!
config ZMK_KEYBOARD_NAME
    default "Mission Control"

config ZMK_SPLIT_ROLE_CENTRAL
    default y

endif

if SHIELD_MISSION_CONTROL_LEFT || SHIELD_MISSION_CONTROL_RIGHT

config ZMK_SPLIT
    default y

endif
```

## boards/shields/mission_control/Kconfig.shield
```kconfig
config SHIELD_MISSION_CONTROL_LEFT
	def_bool $(shields_list_contains,mission_control_left)

config SHIELD_MISSION_CONTROL_RIGHT
	def_bool $(shields_list_contains,mission_control_right)
```
